## Kconfig
```kconfig
mainmenu "Musictribe RTOS"

menu "Build Setup"

config IMAGE_NAME
        string "Output image filename"
        default "innofw"

menu "Binary output formats" 
config RAW_BINARY
        bool 'Raw binary'
        default y
config INTEL_HEX
        bool "Intel Hex"
        default y
config MUSICTRIBE_SYX
        bool "MusicTribe Syx"
        default y
        depends on INTEL_HEX
endmenu # Binary output formats

choice 
        prompt "Optimization level"
config OPTIMIZATION_NONE
        bool "No optimization"
config OPTIMIZATION_NORMAL
        bool "Normal optimization"
config OPTIMIZATION_AGGRESSIVE
        bool "Aggressive optimization"
endchoice # Optimization level

config GENERATE_LINK_MAP
        bool "Generate link map"

config GENERATE_SYMBOL_FILE
        bool "Generate symbol file"

endmenu # Build Setup

menu "System Type"
source board/Kconfig
endmenu

menu "Board options"
config HAVE_PRODUCT_INFO
        bool "Product Info"

config MANUFACTURER_ID
        hex "Manufacturer ID"
        default 0x112233
        depends on HAVE_PRODUCT_INFO

config MANUFACTURER_ID_LEN
        int "Manufacturer ID length"
        default 3
        depends on HAVE_PRODUCT_INFO

config MODEL_ID
        hex "Model ID"
        default 0x112233
        depends on HAVE_PRODUCT_INFO

config MODEL_ID_LENGTH
        int "Model ID length"
        default 3
        depends on HAVE_PRODUCT_INFO

config MODEL_CODE
        string "Model code"
        default "1234-INNOFW"
        depends on HAVE_PRODUCT_INFO

config MODEL_NAME
        string "Model name"
        default "Shopee devkit"
        depends on HAVE_PRODUCT_INFO


# -----------------

config HAVE_DFU_INFO
        bool "DFU Info"
        help
                Include DFU information on this firmware.


# -----------------

config HAVE_PARAMETERS_INFO
        bool "Parameters Info"
        help
                Include commandline information on this firmware.

config CMDLINE_MAXLEN
        int "Command line maximum buffer size"
        default 16
        depends on HAVE_PARAMETERS_INFO

 


endmenu # "Board options"

menu "Devices"
source device/Kconfig
endmenu

menu "Kernel"
source kernel/Kconfig
endmenu
```

## device/Kconfig
```kconfig
config ADC
        bool "Enable ADC"
        default n

choice 
        prompt "Soft Averaging Algorithm"
        depends on ADC
config ADC_SOFT_NOOP
        bool "Turn Off Software Averaging"
config ADC_SOFT_RA
        bool "Running Average"
config ADC_SOFT_EMA
        bool "Exponential Moving Average"
endchoice #ADC



        
```

## kernel/Kconfig
```kconfig
config TASK_NAME_LENGTH
        int "Task name length"
        default 16

config TASK_STACK_SIZE_SHIFT
        int
        default 10

choice
        prompt "Task stack size"
        default TASK_STACK_2KB
config TASK_STACK_1KB
        bool "1KB stack"
config TASK_STACK_2KB
        bool "2KB stack"
config TASK_STACK_3KB
        bool "3KB stack"
config TASK_STACK_4KB
        bool "4KB stack"
endchoice 

config TASK_STACK_SIZE
        hex
        default 0x400   if TASK_STACK_1KB
        default 0x800   if TASK_STACK_2KB
        default 0xC00   if TASK_STACK_3KB
        default 0x1000  if TASK_STACK_4KB

config TASK_PRIVATE_SIZE
        int "Task private size"
        default 8
        default 16       if CONFIG_ARMV7M
        
config HZ
        int "Kernel tick Hertz"
        default 1000
```

## mcu/gd32f4/Kconfig
```kconfig
comment "GD32F4 Options"

choice 
        prompt "Select GD32F4 Chip"

config GD32F450
        bool "GD32F450"
config GD32F405
        bool "GD32F405"
config GD32F407
        bool "GD32F407"
        select GD32F4_RCU
        select GD32F4_PMU
config GD32F470
        bool "GD32F470"
config GD32F425
        bool "GD32F425"
        select GD32F4_RCU
        select GD32F4_PMU
config GD32F427
        bool "GD32F427"
endchoice

config GD32F4_CHIP
        string
        default "GD32F450"      if GD32F450
        default "GD32F405"      if GD32F405
        default "GD32F407"      if GD32F407
        default "GD32F470"      if GD32F470
        default "GD32F425"      if GD32F425
        default "GD32F427"      if GD32F427


menu "GD32F4 Peripherals"

config GD32F4_ADC
        bool "ADC"
        default n
config GD32F4_CAN
        bool "CAN"
        default n
config GD32F4_CRC
        bool "CRC"
        default n
config GD32F4_CTC
        bool "CTC"
        default n
config GD32F4_DAC
        bool "DAC"
        default n
config GD32F4_DBG
        bool "DBG"
        default n
config GD32F4_DCI
        bool "DCI"
        default n
config GD32F4_DMA
        bool "DMA"
        default n
config GD32F4_ENET
        bool "Enet"
        default n
config GD32F4_EXMC
        bool "Exti"
config GD32F4_EXTI
        bool "Exmc"
        default n
config GD32F4_FMC
        bool "FMC"
        default n
config GD32F4_FWDGT
        bool "FWDGT"
        default n
config GD32F4_GPIO
        bool "GPIO"
        default n
config GD32F4_I2C
        bool "I2C"
        default n
config GD32F4_IPA
        bool "IPA"
        default n
config GD32F4_IREF
        bool "Iref"
        default n
config GD32F4_MISC
        bool "Misc"
        default n
config GD32F4_PMU
        bool "PMU"
        default n
config GD32F4_RCU
        bool "RCU"
        default n
config GD32F4_RTC
        bool "RTC"
        default n
config GD32F4_SDIO
        bool "SDIO"
        default n
config GD32F4_SPI
        bool "SPI"
        default n
config GD32F4_SYSCFG
        bool "SysCfg"
        default n
config GD32F4_TIMER
        bool "Timer"
        default n
config GD32F4_TLI
        bool "TLI"
        default n
config GD32F4_TRNG
        bool "TRNG"
        default n
config GD32F4_USART
        bool "USART"
        default n
config GD32F4_WWDGT
        bool "WWDGT"
        default n
endmenu

choice SYSTEM_CLOCK
        prompt "GD32F4 system clock"
config IRC16M
        bool "ICR16M"
config HXTAL
        bool "HXTAL"
config 120M_PLL_IRC16M
        bool "120M PLL IRC16M"
config 120M_PLL_8M_HXTAL
        bool "120M PLL 8M HXTAL"
config 120M_PLL_25M_HXTAL
        bool "120M PLL 25M HXTAL"
config 168M_PLL_IRC16M
        bool "168M PLL IRC16M"
config 168M_PLL_8M_HXTAL
        bool "168M PLL 8M HXTAL"
config 168M_PLL_25M_HXTAL
        bool "168M PLL 25M HXTAL"
config 200M_PLL_IRC16M
        bool "200M PLL IRC16M"
config 200M_PLL_8M_HXTAL
        bool "200M PLL 8M HXTAL"
config 200M_PLL_25M_HXTAL
        bool "200M PLL 25M HXTAL"
config 240M_PLL_IRC16M
        bool "240M PLL IRC16M"
config 240M_PLL_8M_HXTAL
        bool "240M PLL 8M HXTAL"
config 240M_PLL_25M_HXTAL
        bool "240M PLL 25M HXTAL"
endchoice # CONFIG_SYSTEM_CLOCK

#define __SYSTEM_CLOCK_IRC16M                   (uint32_t)(__IRC16M)
#define __SYSTEM_CLOCK_HXTAL                    (uint32_t)(__HXTAL)
#define __SYSTEM_CLOCK_120M_PLL_IRC16M          (uint32_t)(120000000)
#define __SYSTEM_CLOCK_120M_PLL_8M_HXTAL        (uint32_t)(120000000)
#define __SYSTEM_CLOCK_120M_PLL_25M_HXTAL       (uint32_t)(120000000)
#define __SYSTEM_CLOCK_168M_PLL_IRC16M          (uint32_t)(168000000)
#define __SYSTEM_CLOCK_168M_PLL_8M_HXTAL        (uint32_t)(168000000)
#define __SYSTEM_CLOCK_168M_PLL_25M_HXTAL       (uint32_t)(168000000)
#define __SYSTEM_CLOCK_200M_PLL_IRC16M          (uint32_t)(200000000)
#define __SYSTEM_CLOCK_200M_PLL_8M_HXTAL        (uint32_t)(200000000)
#define __SYSTEM_CLOCK_200M_PLL_25M_HXTAL       (uint32_t)(200000000)
#define __SYSTEM_CLOCK_240M_PLL_IRC16M          (uint32_t)(240000000)
#define __SYSTEM_CLOCK_240M_PLL_8M_HXTAL        (uint32_t)(240000000)
#define __SYSTEM_CLOCK_240M_PLL_25M_HXTAL       (uint32_t)(240000000)

#use this in -DHXTAL_VALUE=$(CONFIG_HXTAL_VALUE)
config HXTAL_VALUE
        int "High speed crystal oscillator (HXTAL) value in Hz"     
        default 8000000         if 120M_PLL_8M_HXTAL || 168M_PLL_8M_HXTAL || 200M_PLL_8M_HXTAL || 240M_PLL_8M_HXTAL
        default 25000000        if 120M_PLL_25M_HXTAL || 168M_PLL_25M_HXTAL || 200M_PLL_25M_HXTAL || 240M_PLL_25M_HXTAL
config HXTAL_STARTUP_TIMEOUT
        hex "High speed crystal oscillator timeout"
        default 0xFFFF

config IRC16M_VALUE
        int
        default 16000000

config LXTAL_VALUE
        int "Low speed crystal oscillator (LXTAL)in Hz"
        default 32768


#use this is -D __SYSTEM_CLOCK_XXX_PLL_XXX=$(CONFIG_SYSTEM_CLOCK_VALUE)
config SYSTEM_CLOCK_VALUE
        int
        default 120000000       if 120M_PLL_IRC16M || 120M_PLL_8M_HXTAL || 120M_PLL_25M_HXTAL
        default 168000000       if 168M_PLL_IRC16M || 168M_PLL_8M_HXTAL || 168M_PLL_25M_HXTAL
        default 200000000       if 200M_PLL_IRC16M || 200M_PLL_8M_HXTAL || 200M_PLL_25M_HXTAL
        default 240000000       if 240M_PLL_IRC16M || 240M_PLL_8M_HXTAL || 240M_PLL_25M_HXTAL
```
